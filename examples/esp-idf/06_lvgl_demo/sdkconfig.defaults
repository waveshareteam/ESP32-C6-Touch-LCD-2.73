## examples/esp-idf/06_lvgl_demo/sdkconfig.defaults
```kconfig
CONFIG_IDF_TARGET="esp32c6"
CONFIG_ESPTOOLPY_FLASHMODE_DIO=y
CONFIG_ESPTOOLPY_FLASHSIZE_16MB=y
CONFIG_FREERTOS_HZ=1000
CONFIG_ESP_MAIN_TASK_STACK_SIZE=8192
CONFIG_LV_USE_CLIB_MALLOC=y
CONFIG_LV_USE_CLIB_STRING=y
CONFIG_LV_USE_CLIB_SPRINTF=y
CONFIG_LV_OS_FREERTOS=y
CONFIG_LV_USE_FLOAT=y
CONFIG_BSP_ERROR_CHECK=n
CONFIG_BSP_LCD_TRANS_QUEUE_DEPTH=2
CONFIG_BSP_DISPLAY_LVGL_BUF_HEIGHT=16
CONFIG_ESP_LVGL_ADAPTER_ENABLE_DECODER=n
CONFIG_ESP_LVGL_ADAPTER_ENABLE_FREETYPE=n
CONFIG_ESP_LVGL_ADAPTER_ENABLE_FS=n
CONFIG_LV_DRAW_SW_DRAW_UNIT_CNT=1
CONFIG_LV_DRAW_LAYER_SIMPLE_BUF_SIZE=8192
CONFIG_LV_DRAW_LAYER_MAX_MEMORY=32768
CONFIG_LV_CACHE_DEF_SIZE=0
CONFIG_LV_IMAGE_HEADER_CACHE_DEF_CNT=0
CONFIG_LV_BIN_DECODER_RAM_LOAD=n
CONFIG_LV_USE_DEMO_WIDGETS=y

CONFIG_LV_FONT_MONTSERRAT_20=y

CONFIG_LV_FONT_MONTSERRAT_28=y
```

## examples/factory/components/Weather/Kconfig
```kconfig
menu "C6 2.73 Weather"
    config C6273_WEATHER_API_ID
        string "Weather service API ID"
        default "10015813"
    config C6273_WEATHER_API_KEY
        string "Weather service API key"
        default "070d8d7113bef63bbad7216a89cb00a4"
    config C6273_WEATHER_PROVINCE
        string "Province sent to API (UTF-8)"
        default "广东"
    config C6273_WEATHER_CITY
        string "City sent to API (UTF-8)"
        default "深圳"
    config C6273_WEATHER_CITY_LABEL
        string "City display name"
        default "Shenzhen"
endmenu
```

## examples/factory/sdkconfig.defaults
```kconfig
CONFIG_IDF_TARGET="esp32c6"
CONFIG_PARTITION_TABLE_CUSTOM=y
CONFIG_COMPILER_OPTIMIZATION_PERF=y
# CONFIG_ESP_WIFI_IRAM_OPT is not set
# CONFIG_ESP_WIFI_EXTRA_IRAM_OPT is not set
# CONFIG_ESP_WIFI_RX_IRAM_OPT is not set
CONFIG_FREERTOS_HZ=1000
CONFIG_ESP_BROOKESIA_ENABLE_AI_FRAMEWORK=n
CONFIG_ESP_BROOKESIA_GUI_ENABLE_ANIM_PLAYER=n
CONFIG_ESP_BROOKESIA_ENABLE_SERVICES=n
CONFIG_ESP_BROOKESIA_SYSTEMS_ENABLE_SPEAKER=n
CONFIG_BOOST_MATH_ENABLED=n
CONFIG_BOOST_SERIALIZATION_ENABLED=n
CONFIG_LV_USE_CLIB_MALLOC=y
CONFIG_LV_USE_CLIB_STRING=y
CONFIG_LV_USE_CLIB_SPRINTF=y
CONFIG_LV_OS_FREERTOS=y
CONFIG_LV_DEF_REFR_PERIOD=15
CONFIG_LV_OBJ_STYLE_CACHE=y
CONFIG_LV_FONT_MONTSERRAT_22=y
CONFIG_LV_USE_QRCODE=y
CONFIG_LV_USE_IMGFONT=y
CONFIG_LV_FONT_FMT_TXT_LARGE=y
CONFIG_ESP_LVGL_ADAPTER_ENABLE_FPS_STATS=y
CONFIG_ESP_MAIN_TASK_STACK_SIZE=8192
CONFIG_LV_FONT_MONTSERRAT_12=y
CONFIG_LV_FONT_MONTSERRAT_14=y
CONFIG_LV_FONT_MONTSERRAT_16=y
CONFIG_LV_FONT_MONTSERRAT_18=y
CONFIG_LV_FONT_MONTSERRAT_20=y
CONFIG_LV_FONT_MONTSERRAT_32=y

# Factory APP layout and SD UTF-8 filenames.
CONFIG_BSP_ERROR_CHECK=n
CONFIG_LV_FONT_MONTSERRAT_24=y
CONFIG_LV_FONT_MONTSERRAT_28=y
CONFIG_LV_FONT_MONTSERRAT_40=y
CONFIG_LV_FONT_MONTSERRAT_48=y
CONFIG_LV_FONT_SOURCE_HAN_SANS_SC_16_CJK=y
CONFIG_FATFS_LFN_NONE=n
CONFIG_FATFS_LFN_HEAP=y
CONFIG_FATFS_MAX_LFN=255
CONFIG_FATFS_API_ENCODING_UTF_8=y
CONFIG_FATFS_CODEPAGE_437=n
CONFIG_FATFS_CODEPAGE_936=y
CONFIG_FATFS_FS_LOCK=8
CONFIG_LWIP_SNTP_MAX_SERVERS=2
CONFIG_BSP_LCD_TRANS_QUEUE_DEPTH=2
CONFIG_LV_USE_CANVAS=y
CONFIG_ESPTOOLPY_FLASHMODE_DIO=y
CONFIG_ESPTOOLPY_FLASHSIZE_16MB=y
CONFIG_PARTITION_TABLE_CUSTOM_FILENAME="partitions.csv"
CONFIG_ESP_CONSOLE_UART_DEFAULT=y
CONFIG_ESP_CONSOLE_SECONDARY_USB_SERIAL_JTAG=y
CONFIG_LV_DRAW_SW_DRAW_UNIT_CNT=1
CONFIG_LV_DRAW_LAYER_SIMPLE_BUF_SIZE=8192
CONFIG_LV_DRAW_LAYER_MAX_MEMORY=32768
CONFIG_LV_CACHE_DEF_SIZE=0
CONFIG_LV_IMAGE_HEADER_CACHE_DEF_CNT=0
CONFIG_BSP_DISPLAY_LVGL_BUF_HEIGHT=16
CONFIG_ESP_LVGL_ADAPTER_ENABLE_DECODER=n
CONFIG_ESP_LVGL_ADAPTER_ENABLE_FREETYPE=n
CONFIG_ESP_LVGL_ADAPTER_ENABLE_FS=n
CONFIG_ESP_WIFI_STATIC_RX_BUFFER_NUM=4
CONFIG_ESP_WIFI_DYNAMIC_RX_BUFFER_NUM=8
CONFIG_ESP_WIFI_DYNAMIC_TX_BUFFER_NUM=8
CONFIG_ESP_WIFI_RX_BA_WIN=4
CONFIG_LWIP_TCP_SND_BUF_DEFAULT=4096
CONFIG_LWIP_TCP_WND_DEFAULT=4096
CONFIG_ESP_MAIN_TASK_STACK_SIZE=8192

# Decode indexed canvas/photos one scanline at a time, not a full ARGB frame.
CONFIG_LV_BIN_DECODER_RAM_LOAD=n
```
